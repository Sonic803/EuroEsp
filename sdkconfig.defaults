## sdkconfig.defaults
```kconfig
CONFIG_IDF_TARGET="esp32s2"
CONFIG_ESP_CONSOLE_USB_CDC=y

# CONFIG_LV_COLOR_DEPTH_1=y
CONFIG_LV_FONT_DEFAULT_MONTSERRAT_10=y
CONFIG_LV_USE_THEME_MONO=y
CONFIG_COMPILER_OPTIMIZATION_PERF=y
CONFIG_ESP_DEFAULT_CPU_FREQ_MHZ_240=y
CONFIG_LV_ATTRIBUTE_FAST_MEM_USE_IRAM=n
CONFIG_LV_MEMCPY_MEMSET_STD=y
# CONFIG_LV_DEF_REFR_PERIOD=10
CONFIG_ESPTOOLPY_FLASHMODE_QIO=y

CONFIG_ESP_CONSOLE_USB_CDC_SUPPORT_ETS_PRINTF=y

# CONFIG_ESP32S2_REV_MIN_1=y

CONFIG_ESP32S2_REV_MIN_0=y
CONFIG_ESP32S2_REV_MIN_FULL=0
CONFIG_ESP_REV_MIN_FULL=0

# CONFIG_LV_USE_OBSERVER=y
# CONFIG_LV_USE_SYSMON=y
# CONFIG_LV_USE_PERF_MONITOR=y


CONFIG_ESP_WIFI_IRAM_OPT=n
CONFIG_ESP_WIFI_RX_IRAM_OPT=n

# CONFIG_SPIRAM=y
# CONFIG_SPIRAM_SPEED_80M=y
# CONFIG_SPIRAM_ALLOW_BSS_SEG_EXTERNAL_MEMORY=y
# CONFIG_SPIRAM_ALLOW_NOINIT_SEG_EXTERNAL_MEMORY=y
# CONFIG_SPIRAM_XIP_FROM_PSRAM=y
```
